## boards/shields/simple34/Kconfig.defconfig
```kconfig
if SHIELD_SIMPLE34_DONGLE

config ZMK_KEYBOARD_NAME
    default "Simple34"

config ZMK_SPLIT_ROLE_CENTRAL
    default y

config ZMK_SPLIT_BLE_CENTRAL_PERIPHERALS
    default 2

endif

if SHIELD_SIMPLE34_LEFT || SHIELD_SIMPLE34_RIGHT || SHIELD_SIMPLE34_DONGLE

config ZMK_SPLIT
    default y

config ZMK_BLE
    default y

if ZMK_STUDIO

config USB_DEVICE_STACK
    default y

config USB_DEVICE_MANUFACTURER
    default "Simple34"

config USB_DEVICE_VID
    default 0x1D50

config USB_DEVICE_PID
    default 0x615E

config ZMK_USB
    default y

endif # ZMK_STUDIO

endif
```

## boards/shields/terence0/Kconfig.defconfig
```kconfig
if SHIELD_TERENCE0_DONGLE

config ZMK_KEYBOARD_NAME
    default "Terence0"

config ZMK_SPLIT_ROLE_CENTRAL
    default y

config ZMK_SPLIT_BLE_CENTRAL_PERIPHERALS
    default 2

endif

if SHIELD_TERENCE0_LEFT || SHIELD_TERENCE0_RIGHT || SHIELD_TERENCE0_DONGLE

config ZMK_SPLIT
    default y

config ZMK_BLE
    default y

if ZMK_STUDIO

config USB_DEVICE_STACK
    default y

config USB_DEVICE_MANUFACTURER
    default "Terence0"

config USB_DEVICE_VID
    default 0x1D50

config USB_DEVICE_PID
    default 0x615E

config ZMK_USB
    default y

endif # ZMK_STUDIO

endif
```
